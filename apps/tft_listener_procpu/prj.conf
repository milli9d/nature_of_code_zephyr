## CMakeLists.txt
```
# cmake boilerplate
cmake_minimum_required(VERSION 3.30.2)

# add modules
list(APPEND EXTRA_ZEPHYR_MODULES
    ${CMAKE_CURRENT_SOURCE_DIR}/../../modules/nature_of_code
)

# import custom board package
# list(APPEND BOARD_ROOT ${CMAKE_CURRENT_SOURCE_DIR}/../../)

# import overlays for CPUs
set(DTC_OVERLAYS_DIR  ${CMAKE_CURRENT_SOURCE_DIR}/../../overlays)
set(DTC_OVERLAY_FILE ${DTC_OVERLAYS_DIR}/waveshare_1_69_touch_tft_esp32s3.overlay)

# add drivers

# add modules
set(EXTRA_CONF_FILE ${CMAKE_CURRENT_SOURCE_DIR}/prj.conf)

# add zephyr package
find_package(Zephyr REQUIRED HINTS $ENV{ZEPHYR_BASE})

# declare project
project(random_walker)

# add sources
file(GLOB_RECURSE srcs ${CMAKE_CURRENT_SOURCE_DIR}/src/*.c*)

target_sources(app
    PRIVATE ${srcs}
)

target_include_directories(app
    PUBLIC ${CMAKE_CURRENT_SOURCE_DIR}/include/
)
```

## prj.conf
```kconfig
CONFIG_ASSERT=y

CONFIG_ESPTOOLPY_FLASHMODE_QIO=y
CONFIG_ESPTOOLPY_FLASHFREQ_80M=y
CONFIG_ESPTOOLPY_FLASHSIZE_8MB=y

# bootloader
# CONFIG_BOOTLOADER_MCUBOOT=y

# compiler settings
CONFIG_CPP=y
CONFIG_STD_CPP2B=y
CONFIG_REQUIRES_FULL_LIBCPP=y
CONFIG_CPP_EXCEPTIONS=y
CONFIG_CPP_RTTI=y

CONFIG_NEWLIB_LIBC=y
CONFIG_COMMON_LIBC_ASCTIME_R=y
CONFIG_COMMON_LIBC_CTIME_R=y
CONFIG_COMMON_LIBC_MALLOC=y
CONFIG_NEWLIB_LIBC_FLOAT_PRINTF=y
CONFIG_NEWLIB_LIBC_HEAP_LISTENER=y

CONFIG_STD_C23=y
CONFIG_GNU_C_EXTENSIONS=y
CONFIG_DEBUG_OPTIMIZATIONS=y
CONFIG_COMPILER_WARNINGS_AS_ERRORS=y
CONFIG_COMPILER_SAVE_TEMPS=y
CONFIG_FORTIFY_SOURCE_RUN_TIME=y
# CONFIG_MISRA_SANE=y
CONFIG_HEAP_MEM_POOL_SIZE=131072

CONFIG_SYS_HASH_FUNC32=y
CONFIG_SYS_HASH_MAP=y
CONFIG_SHARED_MULTI_HEAP=y

#debug settings
CONFIG_PRINTK=y

CONFIG_LOG=y
CONFIG_LOG_DEFAULT_LEVEL=3

# shell settings
CONFIG_SHELL=y
CONFIG_SHELL_PROMPT_UART="¯\\_(ツ)_/¯ =:"

CONFIG_FILE_SYSTEM_SHELL=y

CONFIG_GPIO=y
CONFIG_GPIO_SHELL=y

CONFIG_I2C=y
CONFIG_I2C_SHELL=y

CONFIG_SPI=y
CONFIG_SPI_SHELL=y

CONFIG_DISPLAY=y
CONFIG_INPUT=y
CONFIG_INPUT_EVENT_DUMP=y

CONFIG_NATURE_OF_CODE=y
```

## src/main.cpp
```c
#include <zephyr/kernel.h>
#include <zephyr/init.h>
#include <zephyr/display/cfb.h>
#include <zephyr/drivers/gpio.h>
#include <zephyr/logging/log.h>
LOG_MODULE_REGISTER(main);

#include <frame_buffer.hpp>
#include <pin_defines.hpp>

/* TODO: Get from device tree */
#define TFT_W     240u
#define TFT_H     280u
#define TFT_X_OFF 0u
#define TFT_Y_OFF 20u
#define TFT_BPP   2u

/* ========================================================================= */
/* INIT Section */
/* ========================================================================= */

/**
 * @brief init TFT LED light
 * @return
 */
static int init_tft_led()
{
    /* turn on TFT LED */
    const struct gpio_dt_spec tft_led = TFT_LED_GPIO;
    gpio_pin_configure_dt(&tft_led, GPIO_OUTPUT_ACTIVE | GPIO_ACTIVE_HIGH);
    return 0;
}
SYS_INIT(init_tft_led, APPLICATION, CONFIG_APPLICATION_INIT_PRIORITY);

/* ========================================================================= */
/* Main Section */
/* ========================================================================= */

static void tft_test()
{
    static noc::frame_buffer frame_buf(TFT_W, TFT_H, TFT_BPP);

    // uint16_t color = rand() % UINT16_MAX;
    // frame_buf.fill_buffer((uint8_t*)&color, sizeof(color));
    frame_buf.fill_buffer_rand();

    const struct device* dev = DEVICE_DT_GET(DT_CHOSEN(zephyr_display));
    if (!device_is_ready(dev)) {
        printk("Device %s not ready\n", dev->name);
        return;
    }

    if (display_set_pixel_format(dev, PIXEL_FORMAT_RGB_565) != 0) {
        printk("Failed to set required pixel format\n");
        return;
    }

    int rc = display_blanking_off(dev);
    if (rc != 0) {
        printk("Failed to turn on display blanking: %d\n", rc);
    }

    struct display_buffer_descriptor _desc = { .buf_size         = ((TFT_W * TFT_H) * TFT_BPP),
                                               .width            = TFT_W,
                                               .height           = TFT_H,
                                               .pitch            = TFT_W,
                                               .frame_incomplete = false };

    rc = display_write(dev, TFT_X_OFF, TFT_Y_OFF, &_desc, (void*)frame_buf.get_buffer());
    if (rc != 0) {
        printk("Failed to write to display: %d\n", rc);
    }
}

int main()
{
    while (1) {
        tft_test();
        LOG_DBG("Main is running");
        k_sleep(K_MSEC(30));
    }

    return 0;
}
```
