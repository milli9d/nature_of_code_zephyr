## CMakeLists.txt
```
# cmake boilerplate
cmake_minimum_required(VERSION 3.30.2)

# add modules
list(APPEND EXTRA_ZEPHYR_MODULES
    ${CMAKE_CURRENT_SOURCE_DIR}/../../modules/nature_of_code
    ${CMAKE_CURRENT_SOURCE_DIR}/../../modules/reiki_sdk_zephyr
)

# import custom board package
# list(APPEND BOARD_ROOT ${CMAKE_CURRENT_SOURCE_DIR}/../../)

# import overlays for CPUs
set(DTC_OVERLAYS_DIR ${CMAKE_CURRENT_SOURCE_DIR}/../../overlays)

# set(DTC_OVERLAY_FILE ${DTC_OVERLAYS_DIR}/waveshare_1_69_touch_tft_esp32s3.overlay)
# set(DTC_OVERLAY_FILE ${DTC_OVERLAYS_DIR}/waveshare_1_47_tft_esp32c6.overlay)

# add drivers

# add modules
set(EXTRA_CONF_FILE ${CMAKE_CURRENT_SOURCE_DIR}/prj.conf)

# add zephyr package
find_package(Zephyr REQUIRED HINTS $ENV{ZEPHYR_BASE})

# declare project
project(random_walker)

# add sources
file(GLOB_RECURSE srcs ${CMAKE_CURRENT_SOURCE_DIR}/src/*.c*)

target_sources(app
    PRIVATE ${srcs}
)

target_include_directories(app
    PUBLIC ${CMAKE_CURRENT_SOURCE_DIR}/include/
)
```

## prj.conf
```kconfig
CONFIG_ASSERT=y

CONFIG_ESPTOOLPY_FLASHMODE_QIO=y
CONFIG_ESPTOOLPY_FLASHFREQ_80M=y
CONFIG_ESPTOOLPY_FLASHSIZE_8MB=y

# bootloader
# CONFIG_BOOTLOADER_MCUBOOT=y

# compiler settings
CONFIG_CPP=y
CONFIG_STD_CPP2B=y
CONFIG_REQUIRES_FULL_LIBCPP=y
CONFIG_CPP_EXCEPTIONS=y
CONFIG_CPP_RTTI=y

CONFIG_NEWLIB_LIBC=y
CONFIG_COMMON_LIBC_ASCTIME_R=y
CONFIG_COMMON_LIBC_CTIME_R=y
CONFIG_COMMON_LIBC_MALLOC=y
CONFIG_NEWLIB_LIBC_FLOAT_PRINTF=y
CONFIG_NEWLIB_LIBC_HEAP_LISTENER=y

CONFIG_STD_C23=y
CONFIG_GNU_C_EXTENSIONS=y
CONFIG_DEBUG_OPTIMIZATIONS=y
CONFIG_COMPILER_WARNINGS_AS_ERRORS=y
CONFIG_COMPILER_SAVE_TEMPS=y
CONFIG_FORTIFY_SOURCE_RUN_TIME=y
# CONFIG_MISRA_SANE=y
CONFIG_HEAP_MEM_POOL_SIZE=131072

CONFIG_SYS_HASH_FUNC32=y
CONFIG_SYS_HASH_MAP=y
CONFIG_SHARED_MULTI_HEAP=y

#debug settings
CONFIG_PRINTK=y

CONFIG_LOG=y
CONFIG_LOG_DEFAULT_LEVEL=3

# shell settings
CONFIG_SHELL=y
CONFIG_SHELL_PROMPT_UART="¯\\_(ツ)_/¯ =:"

CONFIG_FILE_SYSTEM_SHELL=y

CONFIG_GPIO=y
CONFIG_GPIO_SHELL=y

CONFIG_I2C=y
CONFIG_I2C_SHELL=y

CONFIG_SPI=y
CONFIG_SPI_SHELL=y

CONFIG_NATURE_OF_CODE=y
CONFIG_ENTROPY_DEVICE_RANDOM_GENERATOR=y
CONFIG_ENTROPY_GENERATOR=y
```

## src/main.cpp
```c
#include <cstdint>
#include <cstdlib>
#include <ctime>
#include <cstdbool>

#include <zephyr/kernel.h>
#include <zephyr/init.h>
#include <zephyr/display/cfb.h>
#include <zephyr/drivers/gpio.h>
#include <zephyr/drivers/pwm.h>
#include <zephyr/random/random.h>
#include <zephyr/input/input.h>
#include <zephyr/logging/log.h>
LOG_MODULE_REGISTER(main);

#include <canvas.hpp>
#include <random_walker.hpp>
#include <frame_buffer.hpp>
#include <pin_defines.hpp>

/* TODO: Get from device tree */
#define TFT_W     240u
#define TFT_H     280u
#define TFT_X_OFF 0u
#define TFT_Y_OFF 0u
#define TFT_BPP   2u

#define TFT_LED_BRIGHTNESS 1u // 60% brightness

/* ========================================================================= */
/* INIT Section */
/* ========================================================================= */

/**
 * @brief init TFT LED light
 * @return
 */
static int init_tft_led()
{
    /* turn on PWM led0 at 80% brightness */
    const struct pwm_dt_spec tft_led = PWM_DT_SPEC_GET(DT_ALIAS(pwm_lcd0));
    if (!pwm_is_ready_dt(&tft_led)) {
        LOG_ERR("TFT LED PWM device not ready");
        return -ENODEV;
    }

    int rc = pwm_set_pulse_dt(&tft_led, (tft_led.period * TFT_LED_BRIGHTNESS) / 100u);
    if (rc != 0) {
        LOG_ERR("Failed to set TFT LED PWM pulse: %d", rc);
        return rc;
    }

    return 0;
}

SYS_INIT(init_tft_led, APPLICATION, CONFIG_APPLICATION_INIT_PRIORITY);

/* ========================================================================= */
/* Private */
/* ========================================================================= */

#ifdef CONFIG_INPUT
static const struct device* const touch_dev = DEVICE_DT_GET(DT_CHOSEN(zephyr_input));
K_SEM_DEFINE(ts_sync, 0, 1);

static struct {
    size_t x;
    size_t y;
    bool   pressed;
} touch_point, touch_point_drawn;

static void touch_event_callback(struct input_event* evt, void* user_data)
{
    if (evt->code == INPUT_ABS_X) {
        touch_point.x = evt->value;
    }
    if (evt->code == INPUT_ABS_Y) {
        touch_point.y = evt->value;
    }
    if (evt->code == INPUT_BTN_TOUCH) {
        touch_point.pressed = evt->value;
    }

    if (evt->sync) {
        LOG_DBG("Touch event: code=%d, value=%d, x=%zu, y=%zu, pressed=%d", evt->code, evt->value,
                touch_point.x, touch_point.y, touch_point.pressed);
        if (touch_point.pressed) {
            k_sem_give(&ts_sync);
        }
    }
}
INPUT_CALLBACK_DEFINE(touch_dev, touch_event_callback, NULL);
#endif

static int clear_screen(const struct device* dev)
{
    noc::canvas::canvas_cfg_t _cfg = { .w_pix = 1u,
                                       .h_pix = 1u,
                                       .x_max = TFT_W,
                                       .y_max = TFT_H,
                                       .bpp   = 2u };

    noc::canvas               _canvas = noc::canvas(_cfg);
    display_buffer_descriptor desc    = { .buf_size = _canvas.get_frame_buffer().get_size(),
                                          .width    = (uint16_t)_canvas.get_frame_buffer().get_width(),
                                          .height = (uint16_t)_canvas.get_frame_buffer().get_height(),
                                          .pitch  = (uint16_t)_canvas.get_frame_buffer().get_width(),
                                          .frame_incomplete = false };

    /* Fill the canvas with random colors */
    int rc = display_write(dev, TFT_X_OFF, TFT_Y_OFF, &desc, (void*)_canvas.get_frame_buffer_raw());
    if (rc != 0) {
        LOG_ERR("Failed to write to display: %d", rc);
        return rc;
    }
    return 0;
}

/* ========================================================================= */
/* Main Section */
/* ========================================================================= */

int main()
{
    const struct device* dev = DEVICE_DT_GET(DT_CHOSEN(zephyr_display));
    if (!device_is_ready(dev)) {
        LOG_ERR("Device %s not ready", dev->name);
        return -ENODEV;
    }

    if (display_set_pixel_format(dev, PIXEL_FORMAT_RGB_565) != 0) {
        LOG_ERR("Failed to set required pixel format");
        return -ENOSYS;
    }

    int rc = display_blanking_off(dev);
    if (rc != 0) {
        LOG_ERR("Failed to turn on display blanking: %d", rc);
        return rc;
    }

    rc = clear_screen(dev);
    if (rc != 0) {
        LOG_ERR("Failed to clear screen: %d", rc);
        return rc;
    }

    /* initialize the random walker */
    uint32_t                  count = 0;
    uint16_t                  color = sys_rand16_get() % UINT16_MAX;
    static noc::random_walker _rand_walk =
        noc::random_walker(sys_rand32_get() % TFT_W, sys_rand32_get() % TFT_H);

    while (1) {
#ifdef CONFIG_INPUT
        if (k_sem_take(&ts_sync, K_NO_WAIT) == 0) {
            rc = clear_screen(dev);
            if (rc != 0) {
                LOG_ERR("Failed to clear screen: %d", rc);
                return rc;
            }
            color            = sys_rand16_get() % UINT16_MAX;
            _rand_walk.pos.x = touch_point.x;
            _rand_walk.pos.y = touch_point.y;
            LOG_DBG("TOUCH %s X, Y: (%zu, %zu)", touch_point.pressed ? "PRESS" : "RELEASE",
                    touch_point.x, touch_point.y);
        }
#endif
        /* randomize color for artistic results */
        if (count % 2000u == 0) {
            color = sys_rand16_get() % UINT16_MAX;
        }

        /* draw current pixel */
        struct display_buffer_descriptor desc = { .buf_size         = sizeof(color),
                                                  .width            = 1u,
                                                  .height           = 1u,
                                                  .pitch            = 1u,
                                                  .frame_incomplete = false };
        rc = display_write(dev, TFT_X_OFF + _rand_walk.pos.x, TFT_Y_OFF + _rand_walk.pos.y, &desc,
                           &color);
        if (rc != 0) {
            LOG_ERR("Failed to write to display: %d", rc);
            return rc;
        }

        /* get next pixel location */
        (void)_rand_walk.next();
        count++;

        k_sleep(K_USEC(1u));
    }

    return 0;
}
```

## include/pin_defines.hpp
```c
#pragma once

#include <stdio.h>
#include <stdlib.h>

#include <zephyr/kernel.h>
#include <zephyr/drivers/gpio.h>

#define ZEPHYR_USER_NODE DT_PATH(zephyr_user)
#define TFT_LED_GPIO     GPIO_DT_SPEC_GET(ZEPHYR_USER_NODE, tft_led_gpios)
```

## src/tft_task.cpp
```c
// static void tft_test()
// {
//     static noc::frame_buffer frame_buf(TFT_W, TFT_H, TFT_BPP);

//     // uint16_t color = rand() % UINT16_MAX;
//     // frame_buf.fill_buffer((uint8_t*)&color, sizeof(color));
//     frame_buf.fill_buffer_rand();

//     const struct device* dev = DEVICE_DT_GET(DT_CHOSEN(zephyr_display));
//     if (!device_is_ready(dev)) {
//         printk("Device %s not ready\n", dev->name);
//         return;
//     }

//     if (display_set_pixel_format(dev, PIXEL_FORMAT_RGB_565) != 0) {
//         printk("Failed to set required pixel format\n");
//         return;
//     }

//     int rc = display_blanking_off(dev);
//     if (rc != 0) {
//         printk("Failed to turn on display blanking: %d\n", rc);
//     }

//     struct display_buffer_descriptor _desc = { .buf_size         = ((TFT_W * TFT_H) * TFT_BPP),
//                                                .width            = TFT_W,
//                                                .height           = TFT_H,
//                                                .pitch            = TFT_W,
//                                                .frame_incomplete = false };

//     rc = display_write(dev, TFT_X_OFF, TFT_Y_OFF, &_desc, (void*)frame_buf.get_buffer());
//     if (rc != 0) {
//         printk("Failed to write to display: %d\n", rc);
//     }
// }
```
